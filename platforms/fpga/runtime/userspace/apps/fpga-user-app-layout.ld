
/* Licensed under the Apache-2.0 license */
TBF_HEADER_SIZE = 0x84;
FLASH_START = 0xa8c19000;
FLASH_LENGTH = 0x4a500;
RAM_START = 0xa8c64000;
RAM_LENGTH = 0x1d000;
INCLUDE platforms/fpga/runtime/userspace/apps/app_layout.ld
